&{/soc} {
	pcie: pcie@fc000000 {
		compatible = "amlogic,g12a-pcie", "snps,dw-pcie";
		reg = <0x0 0xf5000000 0x0 0x400000>,
		      <0x0 0xfe02c000 0x0 0x2000>,
		      <0x0 0xf5400000 0x0 0x200000>,
		      <0x0 0xfe02a000 0x0 0x2000>,
		      <0x0 0xfe002044 0x0 0x10>;
		reg-names = "elbi", "cfg", "config", "phy", "reset";
		interrupts = <GIC_SPI 141 IRQ_TYPE_LEVEL_HIGH>;
		#interrupt-cells = <1>;
		interrupt-map-mask = <0 0 0 0>;
		interrupt-map = <0 0 0 0 &gic GIC_SPI 143 IRQ_TYPE_LEVEL_HIGH>;
		bus-range = <0x0 0xff>;
		#address-cells = <3>;
		#size-cells = <2>;
		device_type = "pci";
		ranges = <0x81000000 0 0 0x0 0xf5600000 0 0x00100000>,
			 <0x82000000 0 0xf5700000 0x0 0xf5700000 0 0x1900000>;

		clocks = <&clkc CLKID_PCIE_PHY
			  &clkc CLKID_PCIE_COMB
			  &clkc CLKID_PCIE_PLL>;
		clock-names = "general",
			      "pclk",
			      "port";
		pcie-apb-rst-bit = <14>;
		pcie-phy-rst-bit = <13>;
		pcie-ctrl-rst-bit = <12>;
		reset-gpios = <&gpio GPIOH_3 GPIO_ACTIVE_HIGH>;
		num-lanes = <1>;
		status = "okay";
	};
};
